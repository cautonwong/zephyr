## apps/ref_6dof_sensor/Kconfig
```kconfig
# Kconfig for ref_6dof_sensor
mainmenu "6DoF IMU Sensor Fusion Kalman Filter"

source "Kconfig.zephyr"
```

## apps/ref_bms_eis/Kconfig
```kconfig
# Kconfig for ref_bms_eis
mainmenu "BMS Battery Impedance Spectroscopy"

source "Kconfig.zephyr"
```

## apps/ref_drone_fcc/Kconfig
```kconfig
# Kconfig for ref_drone_fcc
mainmenu "Drone Flight Control Computer"

source "Kconfig.zephyr"
```

## apps/ref_medical_wearable/Kconfig
```kconfig
# Kconfig for ref_medical_wearable
mainmenu "Medical Wearable Vital Signs Processing"

source "Kconfig.zephyr"
```

## apps/ref_motor_pred_maint/Kconfig
```kconfig
# Kconfig for ref_motor_pred_maint
mainmenu "Industrial Motor Vibration and Current Diagnostics"

source "Kconfig.zephyr"
```

## apps/ref_motor_pred_maint/boards/native_sim.conf
```kconfig
# native_sim config for ref_motor_pred_maint
CONFIG_SERIAL=y
CONFIG_LOG=y
CONFIG_CONTROL=y
CONFIG_CONTROL_SPECTRUM=y
CONFIG_NEWLIB_LIBC=y
CONFIG_HEAP_MEM_POOL_SIZE=32768
```

## apps/ref_nir_spectrometer/Kconfig
```kconfig
# Kconfig for ref_nir_spectrometer
mainmenu "Portable Near-Infrared Spectrometer Processing"

source "Kconfig.zephyr"
```

## apps/ref_power_quality/Kconfig
```kconfig
# Kconfig for ref_power_quality
mainmenu "Smart Grid Power Quality Monitoring (THD & Sag/Swell)"

source "Kconfig.zephyr"
```

## apps/ref_radar_ranging/Kconfig
```kconfig
# Kconfig for ref_radar_ranging
mainmenu "Industrial 24GHz mmWave Radar & Ultrasonic Ranging"

source "Kconfig.zephyr"
```

## apps/ref_v2g_charger/Kconfig
```kconfig
# Kconfig for ref_v2g_charger
mainmenu "Vehicle to Grid EV Charging Controller"

source "Kconfig.zephyr"
```

## apps/vango_demo/testcase.yaml
```yaml
tests:
  vango_v32f20x_demo.basic:
    tags:
      - vango
      - uart
      - gpio
    platform_allow:
      - v32f20x_board
    harness: console
    harness_config:
      type: one_line
      regex:
        - "Hello, V32F20X!"

  vango_v32f20x_demo.ota:
    tags:
      - vango
      - ota
      - shell
    harness: pytest
    harness_config:
      pytest_root: pytest
    platform_allow:
      - native_sim
    extra_configs:
      - CONFIG_APP_FEATURE_OTA=y
      - CONFIG_JANPATCH=y
```

## drivers/ad7616/Kconfig
```kconfig
# Copyright (c) 2024 Vango Technologies
# SPDX-License-Identifier: Apache-2.0

menuconfig ADC_AD7616
    bool "Analog Devices AD7616 ADC driver"
    default y
    depends on DT_HAS_ANALOG_DEVICES_AD7616_ENABLED
    select SPI
    help
      Enable driver for Analog Devices AD7616 16-bit, 16-channel DAS with
      dual simultaneous sampling ADC.
```

## drivers/sim_axon/Kconfig
```kconfig
# Kconfig for Simulated Axon driver

menuconfig SIM_AXON
	bool "Simulated Axon Accelerator Driver"
	default n
	depends on PM_DEVICE
	help
	  Enable the simulated Axon accelerator driver for PM Runtime verification.
```

## dts/bindings/analog-devices,ad7616.yaml
```yaml
description: |
  Analog Devices AD7616 16-bit, 16-channel, Dual Simultaneous Sampling DAS.
  This driver operates over SPI and utilizes hardware BUSY interrupts for DMA-driven
  asynchronous data acquisition, enabling true 1 MSPS throughput.

compatible: "analog-devices,ad7616"

include: [adc-controller.yaml, spi-device.yaml]

properties:
  reset-gpios:
    type: phandle-array
    required: true
    description: |
      RESET pin (Active Low). Used to hard-reset the ADC during initialization.

  convst-gpios:
    type: phandle-array
    description: |
      CONVST (Conversion Start) pin. Used for manual software-triggered 
      conversions. Provide this if 'pwms' is not used.

  pwms:
    type: phandle-array
    description: |
      PWM channel to drive the CONVST pin for hardware-triggered,
      jitter-free high-speed sampling (up to 1 MSPS).

  busy-gpios:
    type: phandle-array
    required: true
    description: |
      BUSY pin (Active High, triggers on falling edge). Indicates that 
      conversion is complete and data is ready to be fetched via SPI DMA.

  "#io-channel-cells":
    const: 1

  adi,osr:
    type: int
    enum: [0, 2, 4, 8, 16, 32, 64, 128]
    default: 0
    description: |
      Oversampling ratio. The hardware applies a digital low-pass filter
      to achieve higher SNR at the cost of bandwidth.

  adi,sequencer-en:
    type: boolean
    description: |
      Enable the internal hardware sequencer. When true, allows the ADC
      to automatically cycle through a pre-programmed stack of channels.
```

## dts/bindings/vango,sim-axon.yaml
```yaml
description: Vango Technologies Simulated Axon Accelerator for tinyML PM Verification
compatible: "vango,sim-axon"
include: [base.yaml, pinctrl-device.yaml]

properties:
  reg:
    type: array
    required: true
  status:
    type: string
    required: true
```

## lib/control/Kconfig
```kconfig
# Copyright (c) 2024 EdgeC
# SPDX-License-Identifier: Apache-2.0

config CONTROL
	bool "Control algorithms library"
	help
	  Enable the control algorithms library providing PID, LESO (ADRC),
	  and FFT-based spectrum analysis modules.

if CONTROL

config CONTROL_PID
	bool "PID controller"
	help
	  Enable the PID (Proportional-Integral-Derivative) controller.
	  Provides pid_init() and pid_update() with integral anti-windup
	  clamping and output limiting.

config CONTROL_LESO
	bool "LESO observer"
	help
	  Enable the Linear Extended State Observer (LESO) for Active
	  Disturbance Rejection Control (ADRC). Provides leso_init() and
	  leso_update() based on a second-order state-space formulation.

config CONTROL_SPECTRUM
	bool "Spectrum analysis (CMSIS-DSP FFT)"
	select CMSIS_DSP
	select CMSIS_DSP_TRANSFORM
	select CMSIS_DSP_COMPLEXMATH
	select CMSIS_DSP_STATISTICS
	help
	  Enable FFT-based spectrum analysis using CMSIS-DSP. Provides
	  spectrum_analyze() which computes the magnitude spectrum, finds
	  the peak frequency, and calculates Total Harmonic Distortion (THD).

endif # CONTROL
```

## lib/flashdb/Kconfig
```kconfig
# FlashDB Kconfig

menuconfig FLASHDB
    bool "FlashDB Support"
    select FLASH
    select FLASH_MAP
    help
      Enable FlashDB open-source library.

if FLASHDB

config FLASHDB_WRITE_GRAN
    int "Flash write granularity (bits)"
    default 32
    help
      The write granularity of the flash. For V32F20X, it is 32 bits (4 bytes).

endif
```

## lib/janpatch/Kconfig
```kconfig
config JANPATCH
    bool "Janpatch Delta OTA Engine"
    help
      Enable lightweight binary patching for Delta OTA updates.
```

## tests/algo_dsp/testcase.yaml
```yaml
tests:
  algo_dsp.math.mocking:
    tags: dsp
    harness: ztest
  
  algo_dsp.shell.interaction:
    tags: dsp shell
    harness: pytest
    harness_config:
      pytest_root: pytest
    platform_allow:
      - native_sim
```

## tests/flashdb/testcase.yaml
```yaml
common:
  harness: ztest
  tags: flashdb
tests:
  flashdb.core:
    platform_allow: v32f20x_board/v32f20x/cpuapp
    extra_args: 
      - DTC_OVERLAY_FILE="../apps/vango_demo/targets/v32_cpuapp_gateway/app.overlay"
      - ZEPHYR_MODULES="/workspaces/modules/hal/V32F20X_StdPeriph_Lib_V1.0.6;/workspaces/modules/soc/v32f20x;/workspaces/applications"
```

## tests/ref_6dof_sensor/testcase.yaml
```yaml
tests:
  ref_6dof_sensor.build:
    tags: ref-6dof-sensor build
    platform_allow:
      - native_sim
    build_only: true
    integration_platforms:
      - native_sim
```

## tests/ref_bms_eis/testcase.yaml
```yaml
tests:
  ref_bms_eis.build:
    tags: ref-bms-eis build
    platform_allow:
      - native_sim
    build_only: true
    integration_platforms:
      - native_sim
```

## tests/ref_drone_fcc/testcase.yaml
```yaml
tests:
  ref_drone_fcc.build:
    tags: ref-drone-fcc build
    platform_allow:
      - native_sim
    build_only: true
    integration_platforms:
      - native_sim
```

## tests/ref_medical_wearable/testcase.yaml
```yaml
tests:
  ref_medical_wearable.build:
    tags: ref-medical-wearable build
    platform_allow:
      - native_sim
    build_only: true
    integration_platforms:
      - native_sim
```
