## tests/ref_motor_pred_maint/testcase.yaml
```yaml
tests:
  motor_pred_maint.build:
    tags: motor control dsp
    platform_allow:
      - native_sim
    build_only: true
    integration_platforms:
      - native_sim
    extra_configs:
      - CONFIG_CONTROL=y
      - CONFIG_CONTROL_SPECTRUM=y

  motor_pred_maint.console:
    tags: motor control dsp
    platform_allow:
      - native_sim
    harness: console
    harness_config:
      type: one_line
      regex:
        - "ref_motor_pred_maint initialization complete"
    integration_platforms:
      - native_sim
    extra_configs:
      - CONFIG_CONTROL=y
      - CONFIG_CONTROL_SPECTRUM=y
```

## tests/ref_nilm_meter/testcase.yaml
```yaml
tests:
  nilm_meter.build:
    tags: nilm cnn power
    platform_allow:
      - native_sim
    build_only: true
    integration_platforms:
      - native_sim

  nilm_meter.console:
    tags: nilm cnn power
    platform_allow:
      - native_sim
    harness: console
    harness_config:
      type: one_line
      regex:
        - "NILM Classification Summary"
```

## tests/ref_nir_spectrometer/testcase.yaml
```yaml
tests:
  ref_nir_spectrometer.build:
    tags: ref-nir-spectrometer build
    platform_allow:
      - native_sim
    build_only: true
    integration_platforms:
      - native_sim
```

## tests/ref_power_quality/testcase.yaml
```yaml
tests:
  ref_power_quality.build:
    tags: ref-power-quality build
    platform_allow:
      - native_sim
    build_only: true
    integration_platforms:
      - native_sim
```

## tests/ref_radar_ranging/testcase.yaml
```yaml
tests:
  ref_radar_ranging.build:
    tags: ref-radar-ranging build
    platform_allow:
      - native_sim
    build_only: true
    integration_platforms:
      - native_sim
```

## tests/ref_v2g_charger/testcase.yaml
```yaml
tests:
  ref_v2g_charger.build:
    tags: ref-v2g-charger build
    platform_allow:
      - native_sim
    build_only: true
    integration_platforms:
      - native_sim
```

## tests/vango_demo/testcase.yaml
```yaml
tests:
  vango.ota.janpatch:
    tags: ota janpatch
    harness: ztest
    platform_allow:
      - native_sim
    integration_platforms:
      - native_sim

  vango.dual_core.build:
    tags: vango dual renode
    build_only: true
    platform_allow:
      - native_sim
    extra_args:
      - CONFIG_APP_FEATURE_OTA=n
    extra_configs:
      - CONFIG_JANPATCH=n
```

## west.yml
```yaml
# Copyright (c) 2024 Vango Technologies
# SPDX-License-Identifier: Apache-2.0

manifest:
  self:
    west-commands: scripts/west-commands.yml

  remotes:
    - name: zephyrproject-rtos
      url-base: https://github.com/zephyrproject-rtos
    - name: cautonwong
      url-base: https://github.com/cautonwong

  projects:
    - name: zephyr
      remote: zephyrproject-rtos
      revision: main
      import: true

    # Zephyr Modules Repository
    - name: zephyr_modules
      remote: cautonwong
      revision: main
      path: modules
```
